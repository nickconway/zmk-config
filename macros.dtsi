m1: m1 {
    compatible = "zmk,behavior-macro";
    label = "MACRO_1";
    #binding-cells = <0>;
    bindings = <&macro_tap &kp LA(SPC)>;
};

m2: m2 {
    compatible = "zmk,behavior-macro";
    label = "MACRO_2";
    #binding-cells = <0>;
    bindings = <&macro_tap &kp ENTER &tog GAMET>;
};

m3: m3 {
    compatible = "zmk,behavior-macro";
    label = "MACRO_3";
    #binding-cells = <0>;
    bindings = <&macro_tap &kp LSHFT &kp A &kp B &kp C>;
};
