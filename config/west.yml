## config/west.yml
```yaml
manifest:
    remotes:
        - name: zmkfirmware
          url-base: https://github.com/zmkfirmware
        - name: nickconway
          url-base: https://github.com/nickconway
        - name: amgskobo
          url-base: https://github.com/amgskobo
        - name: carrefinho
          url-base: https://github.com/carrefinho
        - name: oleksandrmaslov
          url-base: https://github.com/oleksandrmaslov
    projects:
        - name: zmk
          remote: nickconway
          revision: dev
          import: app/west.yml
        - name: zmk-keyboard-rollow
          remote: nickconway
          revision: main
          path: extra-modules/rollow
          import: config/west.yml
        - name: zmk-keyboard-toucan
          remote: nickconway
          revision: main
          path: extra-modules/toucan
          import: config/west.yml
        - name: zmk-input-inertia
          remote: nickconway
          revision: include-fix
          path: extra-modules/inertia
        - name: prospector-zmk-module
          remote: carrefinho
          revision: feat/new-status-screens
          path: extra-modules/prospector
        - name: zmk-pointing-acceleration
          remote: oleksandrmaslov
          revision: main
          path: extra-modules/acceleration
        - name: zmk-snippet-ble-low-latency
          remote: nickconway
          revision: main
          path: extra-modules/zmk-ble-low-latency
    self:
        path: config
```
