/*                KEY POSITIONS

  ╭────────────────────────╮ ╭────────────────────────╮
  │ 0   1   2   3   4   5  │ │ 6   7   8   9   10  11 │
  │ 12  13  14  15  16  17 │ │ 18  19  19  20  22  23 │
  │ 24  25  26  27  28  29 │ │ 30  31  32  33  34  35 │
  ╰───────────╮ 36  37  38 │ │ 39  40  41 ╭───────────╯
              ╰────────────╯ ╰────────────╯ */

#define STRINGIFY(x) #x

#define LAYER(node, \
K00, K01, K02, K03, K04, K05,      K06, K07, K08, K09, K10, K11, \
K12, K13, K14, K15, K16, K17,      K18, K19, K20, K21, K22, K23, \
K24, K25, K26, K27, K28, K29,      K30, K31, K32, K33, K34, K35, \
               K36, K37, K38,      K39, K40, K41, \
                         K42,      K43 \
) \
/ { \
    keymap { \
        compatible = "zmk,keymap"; \
        layer_ ## node { \
            display-name = STRINGIFY(node); \
            bindings = < \
                K00 K01 K02 K03 K04 K05       K06 K07 K08 K09 K10 K11 \
                K12 K13 K14 K15 K16 K17       K18 K19 K20 K21 K22 K23 \
                K24 K25 K26 K27 K28 K29       K30 K31 K32 K33 K34 K35 \
                            K36 K37 K38       K39 K40 K41 \
            >; \
            sensor-bindings = <K42 K43>; \
        }; \
    }; \
};

/* key positions */
#define LT0 1   // left-top row
#define LT1 2
#define LT2 3
#define LT3 4
#define LT4 5

#define RT0 6   // right-top row
#define RT1 7
#define RT2 8
#define RT3 9
#define RT4 10

#define LM0 13  // left-middle row
#define LM1 14
#define LM2 15
#define LM3 16
#define LM4 17

#define RM0 18  // right-middle row
#define RM1 19
#define RM2 20
#define RM3 21
#define RM4 22

#define LB0 25  // left-bottom row
#define LB1 26
#define LB2 27
#define LB3 28
#define LB4 29

#define RB0 30  // right-bottom row
#define RB1 31
#define RB2 32
#define RB3 33
#define RB4 34

#define LH0 36  // left thumb keys
#define LH1 37
#define LH2 38

#define RH0 39  // right thumb keys
#define RH1 40
#define RH2 41

#ifdef CONFIG_ZMK_INPUT_LISTENER
#define TRACKPAD_LISTENER &glidepoint_listener
#endif

#include "include/base.dtsi"
