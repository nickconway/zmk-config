#define MACRO_TAP_TERM 10
#define MACRO_WAIT_TERM 10

#define MACRO(NAME, WAIT, TAP, BINDINGS) \
    / { \
        NAME: NAME { \
            compatible = "zmk,behavior-macro"; \
            #binding-cells = <0>; \
            wait-ms = <WAIT>; \
            tap-ms = <TAP>; \
            bindings = <BINDINGS>; \
        }; \
    };

MACRO(ptrun, MACRO_WAIT_TERM, MACRO_TAP_TERM, &kp LA(SPC))
MACRO(tog_gametype, MACRO_WAIT_TERM, MACRO_TAP_TERM, &kp RET &tog GAME &tog GAMET)
MACRO(keep_awake, MACRO_WAIT_TERM, 600, &mmv MOVE_RIGHT &mmv MOVE_LEFT)

/ {
    dm1: dm1 {
        compatible = "zmk,behavior-dynamic-macro";
        wait-ms = <10>;
        #binding-cells = <1>;
    };
};
