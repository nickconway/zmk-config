#include "general.dtsi"

/ {

    keymap {

        compatible = "zmk,keymap";

        LAYER(Base,
            &none, &kp Q,  &kp W, &kp F, &kp P,   &kp B,               &kp J,   &kp L,   &kp U,       &kp Y,   &kp QUOT,  &none,
            &none, &kp A,  &kp R, &kp S, &kp T,   &kp G,               &kp M,   &kp N,   &kp E,       &kp I,   &kp O,     &none,
            &none, &kp Z,  &kp X, &kp C, &kp D,   &kp V,               &kp K,   &kp H,   &kp CMMA,    &kp DOT, &kp SLASH, &none,
                             &kp ESC, &kp BSPC, &kp DEL,               &kp RET, &kp SPACE, &kp TAB,
                                            &inc_dec_kp A B, &inc_dec_kp C D
        )

    };

};
