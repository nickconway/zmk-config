#define MACRO(NAME, WAIT, TAP, BINDINGS) \
	NAME: NAME { \
		compatible = "zmk,behavior-macro"; \
		label = ZMK_MACRO_STRINGIFY(ZM_##NAME); \
		#binding-cells = <0>; \
        wait-ms = <WAIT>; \
        tap-ms = <TAP>; \
		bindings = <BINDINGS>; \
    };

MACRO(m1, 0, 20, &macro_tap &kp LA(SPC))

#ifdef GAME
MACRO(m2, 0, 20, &macro_tap &kp RET &tog GAME &tog GAMET)
#endif

MACRO(mparen, 0, 20, &macro_tap &kp LPAR &kp RPAR &kp LEFT)
MACRO(mbracket, 0, 20, &macro_tap &kp LBKT &kp RBKT &kp LEFT)
MACRO(mbrace, 0, 20, &macro_tap &kp LBRC &kp RBRC &kp LEFT)

dm1: dm1 {
    compatible = "zmk,behavior-dynamic-macro";
    label = "dynamic-macro-1";
    wait-ms = <10>;
    #binding-cells = <1>;
};
